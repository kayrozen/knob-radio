## firmware/s3_sender/main/Kconfig.projbuild
```kconfig
menu "Preset S3 sender"

choice PRESET_AUDIO_SOURCE
    prompt "PCM audio source"
    default PRESET_AUDIO_SOURCE_TONE
    help
        Selects what feeds the COBS/UART forward link.

        TONE: deterministic test signal (no WiFi). Validates the link/jitter/
        drift path (phases B-D) and builds with plain ESP-IDF.

        ADF: real internet radio via ESP-ADF (WiFi -> http_stream -> decoder ->
        resample -> PCM). Phase E. Requires ESP-ADF (ADF_PATH set at build).

    config PRESET_AUDIO_SOURCE_TONE
        bool "Test tone (phases B-D)"

    config PRESET_AUDIO_SOURCE_ADF
        bool "ESP-ADF internet radio (phase E)"
endchoice

config PRESET_WIFI_SSID
    string "WiFi SSID"
    default "myssid"
    depends on PRESET_AUDIO_SOURCE_ADF

config PRESET_WIFI_PASSWORD
    string "WiFi password"
    default "mypassword"
    depends on PRESET_AUDIO_SOURCE_ADF

choice PRESET_OUTPUT_MODE
    prompt "Audio output path"
    default PRESET_OUTPUT_BT
    help
        BT: stream PCM over COBS/UART to the U4WDH, which is the A2DP source to
        the car (default). ANALOG: the S3 decodes straight to its I2S -> PCM5100
        DAC -> line-out/AUX, with the U4WDH unused for audio (plan §5). Both code
        paths always compile; this only selects the default at boot.

    config PRESET_OUTPUT_BT
        bool "Bluetooth A2DP (via U4WDH)"

    config PRESET_OUTPUT_ANALOG
        bool "Analog line-out (PCM5100 DAC)"
endchoice

config PRESET_ENABLE_HAPTIC
    bool "Enable DRV2605 haptic feedback (shared I2C)"
    default n
    help
        Brings up the DRV2605 LRA driver on the shared I2C bus and plays a short
        effect on station changes, boot, etc. (plan §6). Independent of the UI.

config PRESET_ENABLE_PORTAL
    bool "Enable captive portal for first-run provisioning"
    default n
    depends on PRESET_AUDIO_SOURCE_ADF
    help
        When no Wi-Fi credentials are stored, bring up a SoftAP + captive portal
        to configure Wi-Fi, device name, output mode and the station presets
        (plan §3). With stored credentials the device connects as normal.

config PRESET_ENABLE_LAN_EDITOR
    bool "Enable mDNS <name>.local LAN preset editor"
    default n
    depends on PRESET_AUDIO_SOURCE_ADF
    help
        Once the device is online (normal operation), advertise it on the LAN as
        <device-name>.local via mDNS and serve the installer's preset editor over
        HTTP. Lets you re-pick the five presets from a browser on the same
        network — search live radio / podcasts, paste URLs, set schedules — and
        save them straight to the device (plan §3.5). Persists + reboots.

config PRESET_ENABLE_DEEPSLEEP
    bool "Deep-sleep the S3 when the car (Bluetooth) is gone"
    default n
    depends on PRESET_AUDIO_SOURCE_ADF
    help
        For battery / always-on car use: when Bluetooth has been disconnected
        (engine off) for PRESET_SLEEP_AFTER_S seconds, the S3 enters deep sleep
        to preserve power. It cannot wake on the return UART (GPIO48 is not an
        RTC pin), so it wakes on an RTC timer every PRESET_SLEEP_POLL_S seconds,
        asks the U4WDH whether the car is back, and either resumes (full reboot,
        restoring the saved podcast position) or sleeps again. User activity
        (encoder / touch) pushes the countdown back.

config PRESET_SLEEP_AFTER_S
    int "Seconds without Bluetooth before deep sleep"
    default 60
    depends on PRESET_ENABLE_DEEPSLEEP
    help
        Keep this comfortably above the 10 s podcast-position commit window so
        the resume offset is always saved before sleeping.

config PRESET_SLEEP_POLL_S
    int "Deep-sleep poll interval (wake to check for the car), seconds"
    default 5
    depends on PRESET_ENABLE_DEEPSLEEP

config PRESET_ENABLE_PROVISION
    bool "Enable USB serial provisioning (browser installer)"
    default n
    help
        Listen on the USB-Serial-JTAG console for a PROVISION line from the web
        installer (device name + station presets), persist it and reboot
        (plan §3.4). Requires the USB-Serial-JTAG console.

config PRESET_ENABLE_UI
    bool "Enable LVGL UI on the round display (JC3636W518V2)"
    default n
    help
        Brings up the round LCD (ST77916 QSPI) + LVGL on core 0 to show the
        current station. Independent of the audio path so it can be left off
        while validating audio. Requires the managed LVGL/esp_lvgl_port
        components (fetched automatically when enabled).

config PRESET_ENC_GPIO_A
    int "Rotary encoder phase-A GPIO (EC1)"
    default 8

config PRESET_ENC_GPIO_B
    int "Rotary encoder phase-B GPIO (EC1)"
    default 7

endmenu
```

## firmware/s3_sender/sdkconfig.defaults
```kconfig
# ESP32-S3 sender defaults.

CONFIG_IDF_TARGET="esp32s3"

# --- Flash & partitions (N16R8 module: 16 MB flash) ---
# The default 1 MB app partition can't hold the Phase E ESP-ADF + WiFi binary
# (~1.2 MB), so use a custom table with a 3 MB factory app. See partitions.csv.
CONFIG_ESPTOOLPY_FLASHSIZE_16MB=y
CONFIG_PARTITION_TABLE_CUSTOM=y
CONFIG_PARTITION_TABLE_CUSTOM_FILENAME="partitions.csv"

# --- PSRAM (8 MB on the R8 module; needed by the ADF pipeline in Phase E) ---
CONFIG_SPIRAM=y
CONFIG_SPIRAM_MODE_OCT=y
CONFIG_SPIRAM_SPEED_80M=y

# --- Performance ---
CONFIG_ESP_DEFAULT_CPU_FREQ_MHZ_240=y
CONFIG_FREERTOS_HZ=1000

# --- Logging ---
CONFIG_LOG_DEFAULT_LEVEL_INFO=y

# --- LVGL UI fonts (Phase E, optional UI) ---
# The preset screen uses Montserrat 12/20 in addition to the default 14. These
# symbols come from the lvgl managed component; enabling them is a no-op for
# builds that don't link the UI.
CONFIG_LV_FONT_MONTSERRAT_12=y
CONFIG_LV_FONT_MONTSERRAT_20=y

# --- FreeRTOS ---
# ESP-ADF's audio_pipeline (Phase E) still uses legacy FreeRTOS names
# (xSemaphoreHandle, portTICK_RATE_MS) that IDF v5.x only exposes with the
# backward-compatibility option. ADF's own examples set it; the TONE build
# is unaffected by the extra legacy definitions.
CONFIG_FREERTOS_ENABLE_BACKWARD_COMPATIBILITY=y
```

## firmware/u4wdh_bridge/sdkconfig.defaults
```kconfig
# ESP32-U4WDH bridge defaults.

CONFIG_IDF_TARGET="esp32"

# --- Classic Bluetooth: A2DP source, no BLE ---
CONFIG_BT_ENABLED=y
CONFIG_BT_BLUEDROID_ENABLED=y
CONFIG_BT_CLASSIC_ENABLED=y
CONFIG_BT_A2DP_ENABLE=y
CONFIG_BT_SPP_ENABLED=n
CONFIG_BT_BLE_ENABLED=n
CONFIG_BTDM_CTRL_MODE_BR_EDR_ONLY=y
CONFIG_BTDM_CTRL_MODE_BLE_ONLY=n
CONFIG_BTDM_CTRL_MODE_BTDM=n

# --- Performance: 240 MHz, both cores ---
CONFIG_ESP_DEFAULT_CPU_FREQ_MHZ_240=y
CONFIG_FREERTOS_HZ=1000

# --- Custom partition table (larger app for the BT stack) ---
CONFIG_PARTITION_TABLE_CUSTOM=y
CONFIG_PARTITION_TABLE_CUSTOM_FILENAME="partitions.csv"

# --- Logging ---
CONFIG_LOG_DEFAULT_LEVEL_INFO=y
```
